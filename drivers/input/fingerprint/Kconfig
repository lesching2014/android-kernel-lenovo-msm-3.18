## drivers/input/fingerprint/Kconfig
```kconfig
menuconfig INPUT_FINGERPRINT
	bool "Fingerprint"
	help
	  Say Y here, and a list of supported fingerprint will be displayed.
	  This option doesn't affect the kernel.

	  If unsure, say Y.

if INPUT_TOUCHSCREEN

config CDFINGER_FP
	bool "CDFINGER_FP for Qualcomm package"
	help
	  Say Y here if you have a cdfinger fingerprint.

          If unsure, say N.
#Huaqin modify for silead driver by zhaojunhai1 at 2018/03/02 start
config SLSPI_DRIVER
	tristate "Silead FP spi deriver"
	default y
	help
		support for IPC
#Huaqin modify for silead driver by zhaojunhai1 at 2018/03/02 end
endif
```

## drivers/input/touchscreen/gt917d_zql1657/Kconfig
```kconfig
#
# GT9XX Touchscreen driver configuration
#

config TOUCHSCREEN_GT9_I2C
        bool "GT9XX chipset i2c touchscreen"
		depends on TOUCHSCREEN_GT917D_ZQL1657
		help
		This enables support for GT9XX CHIPSET over I2C based touchscreens.
```

## drivers/misc/dev_info/Kconfig
```kconfig
config HQ_DEV_INFO
	bool "Huaqin dev info support"
	help
	  Show phone all dev info
```
