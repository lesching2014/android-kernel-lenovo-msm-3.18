/* Copyright (c) 2013, The Linux Foundation. All rights reserved.
 *
 * This program is free software; you can redistribute it and/or modify
 * it under the terms of the GNU General Public License version 2 and
 * only version 2 as published by the Free Software Foundation.
 *
 * This program is distributed in the hope that it will be useful,
 * but WITHOUT ANY WARRANTY; without even the implied warranty of
 * MERCHANTABILITY or FITNESS FOR A PARTICULAR PURPOSE.  See the
 * GNU General Public License for more details.
 */

/*---------------------------------------------------------------------------
 * This file is autogenerated file using gcdb parser. Please do not edit it.
 * Update input XML file to add a new entry or update variable in this file
 * VERSION = "1.0"
 *---------------------------------------------------------------------------*/
&mdss_mdp {
	dsi_ili9881c_720x1440_video: qcom,mdss_dsi_ili9881c_720_1440_video {
		qcom,mdss-dsi-panel-name = "ili9881c 720x1440 video mode dsi panel";
		qcom,mdss-dsi-panel-controller = <&mdss_dsi0>;
		qcom,mdss-dsi-panel-type = "dsi_video_mode";
		qcom,mdss-dsi-panel-destination = "display_1";
		qcom,mdss-dsi-panel-framerate = <60>;
		qcom,mdss-dsi-virtual-channel-id = <0>;
		qcom,mdss-dsi-stream = <0>;
		qcom,mdss-dsi-panel-width = <720>;
		qcom,mdss-dsi-panel-height = <1440>;
		qcom,mdss-dsi-h-front-porch = <40>;
		qcom,mdss-dsi-h-back-porch = <44>;
		qcom,mdss-dsi-h-pulse-width = <8>;
		qcom,mdss-dsi-h-sync-skew = <0>;
		qcom,mdss-dsi-v-back-porch = <18>;
		qcom,mdss-dsi-v-front-porch = <2>;
		qcom,mdss-dsi-v-pulse-width = <4>;
		qcom,mdss-dsi-h-left-border = <0>;
		qcom,mdss-dsi-h-right-border = <0>;
		qcom,mdss-dsi-v-top-border = <0>;
		qcom,mdss-dsi-v-bottom-border = <0>;
		qcom,mdss-dsi-bpp = <24>;
		qcom,mdss-dsi-color-order = "rgb_swap_rgb";
		qcom,mdss-dsi-underflow-color = <0xff>;
		qcom,mdss-dsi-border-color = <0>;
		qcom,mdss-dsi-on-command = [39 01 00 00 00 00 04 FF 98 81 03
                  39 01 00 00 00 00 02 01 00
                  39 01 00 00 00 00 02 02 00
                  39 01 00 00 00 00 02 03 53
                  39 01 00 00 00 00 02 04 53
                  39 01 00 00 00 00 02 05 13
                  39 01 00 00 00 00 02 06 04
                  39 01 00 00 00 00 02 07 02
                  39 01 00 00 00 00 02 08 02
                  39 01 00 00 00 00 02 09 00
                  39 01 00 00 00 00 02 0a 00
                  39 01 00 00 00 00 02 0b 00
                  39 01 00 00 00 00 02 0c 00
                  39 01 00 00 00 00 02 0d 00
                  39 01 00 00 00 00 02 0e 00
                  39 01 00 00 00 00 02 0f 00
                  39 01 00 00 00 00 02 10 00
                  39 01 00 00 00 00 02 11 00
                  39 01 00 00 00 00 02 12 00
                  39 01 00 00 00 00 02 13 00
                  39 01 00 00 00 00 02 14 00
                  39 01 00 00 00 00 02 15 00
                  39 01 00 00 00 00 02 16 00
                  39 01 00 00 00 00 02 17 00
                  39 01 00 00 00 00 02 18 00
                  39 01 00 00 00 00 02 19 00
                  39 01 00 00 00 00 02 1a 00
                  39 01 00 00 00 00 02 1b 00
                  39 01 00 00 00 00 02 1c 00
                  39 01 00 00 00 00 02 1d 00
                  39 01 00 00 00 00 02 1e C0
                  39 01 00 00 00 00 02 1f 80
                  39 01 00 00 00 00 02 20 02
                  39 01 00 00 00 00 02 21 09
                  39 01 00 00 00 00 02 22 00
                  39 01 00 00 00 00 02 23 00
                  39 01 00 00 00 00 02 24 00
                  39 01 00 00 00 00 02 25 00
                  39 01 00 00 00 00 02 26 00
                  39 01 00 00 00 00 02 27 00
                  39 01 00 00 00 00 02 28 55
                  39 01 00 00 00 00 02 29 03
                  39 01 00 00 00 00 02 2a 00
                  39 01 00 00 00 00 02 2b 00
                  39 01 00 00 00 00 02 2c 00
                  39 01 00 00 00 00 02 2d 00
                  39 01 00 00 00 00 02 2e 00
                  39 01 00 00 00 00 02 2f 00
                  39 01 00 00 00 00 02 30 00
                  39 01 00 00 00 00 02 31 00
                  39 01 00 00 00 00 02 32 00
                  39 01 00 00 00 00 02 33 00
                  39 01 00 00 00 00 02 34 03
                  39 01 00 00 00 00 02 35 00
                  39 01 00 00 00 00 02 36 05
                  39 01 00 00 00 00 02 37 00
                  39 01 00 00 00 00 02 38 3C
                  39 01 00 00 00 00 02 39 00
                  39 01 00 00 00 00 02 3a 00
                  39 01 00 00 00 00 02 3b 00
                  39 01 00 00 00 00 02 3c 00
                  39 01 00 00 00 00 02 3d 00
                  39 01 00 00 00 00 02 3e 00
                  39 01 00 00 00 00 02 3f 00
                  39 01 00 00 00 00 02 40 00
                  39 01 00 00 00 00 02 41 00
                  39 01 00 00 00 00 02 42 00
                  39 01 00 00 00 00 02 43 00
                  39 01 00 00 00 00 02 44 00
                  39 01 00 00 00 00 02 50 01
                  39 01 00 00 00 00 02 51 23
                  39 01 00 00 00 00 02 52 45
                  39 01 00 00 00 00 02 53 67
                  39 01 00 00 00 00 02 54 89
                  39 01 00 00 00 00 02 55 ab
                  39 01 00 00 00 00 02 56 01
                  39 01 00 00 00 00 02 57 23
                  39 01 00 00 00 00 02 58 45
                  39 01 00 00 00 00 02 59 67
                  39 01 00 00 00 00 02 5a 89
                  39 01 00 00 00 00 02 5b ab
                  39 01 00 00 00 00 02 5c cd
                  39 01 00 00 00 00 02 5d ef
                  39 01 00 00 00 00 02 5e 01
                  39 01 00 00 00 00 02 5f 14
                  39 01 00 00 00 00 02 60 15
                  39 01 00 00 00 00 02 61 0C
                  39 01 00 00 00 00 02 62 0D
                  39 01 00 00 00 00 02 63 0E
                  39 01 00 00 00 00 02 64 0F
                  39 01 00 00 00 00 02 65 10
                  39 01 00 00 00 00 02 66 11
                  39 01 00 00 00 00 02 67 08
                  39 01 00 00 00 00 02 68 02
                  39 01 00 00 00 00 02 69 0A
                  39 01 00 00 00 00 02 6a 02
                  39 01 00 00 00 00 02 6b 02
                  39 01 00 00 00 00 02 6c 02
                  39 01 00 00 00 00 02 6d 02
                  39 01 00 00 00 00 02 6e 02
                  39 01 00 00 00 00 02 6f 02
                  39 01 00 00 00 00 02 70 02
                  39 01 00 00 00 00 02 71 02
                  39 01 00 00 00 00 02 72 06
                  39 01 00 00 00 00 02 73 02
                  39 01 00 00 00 00 02 74 02
                  39 01 00 00 00 00 02 75 14
                  39 01 00 00 00 00 02 76 15
                  39 01 00 00 00 00 02 77 11
                  39 01 00 00 00 00 02 78 10
                  39 01 00 00 00 00 02 79 0f
                  39 01 00 00 00 00 02 7a 0e
                  39 01 00 00 00 00 02 7b 0d
                  39 01 00 00 00 00 02 7c 0c
                  39 01 00 00 00 00 02 7d 06
                  39 01 00 00 00 00 02 7e 02
                  39 01 00 00 00 00 02 7f 0A
                  39 01 00 00 00 00 02 80 02
                  39 01 00 00 00 00 02 81 02
                  39 01 00 00 00 00 02 82 02
                  39 01 00 00 00 00 02 83 02
                  39 01 00 00 00 00 02 84 02
                  39 01 00 00 00 00 02 85 02
                  39 01 00 00 00 00 02 86 02
                  39 01 00 00 00 00 02 87 02
                  39 01 00 00 00 00 02 88 08
                  39 01 00 00 00 00 02 89 02
                  39 01 00 00 00 00 02 8A 02
                  39 01 00 00 00 00 04 FF 98 81 04
                  39 01 00 00 00 00 02 38 01
                  39 01 00 00 00 00 02 39 00
                  39 01 00 00 00 00 02 6C 15
                  39 01 00 00 00 00 02 6E 2F
                  39 01 00 00 00 00 02 6F 55
                  39 01 00 00 00 00 02 8D 1F
                  39 01 00 00 00 00 02 87 BA
                  39 01 00 00 00 00 02 26 76
                  39 01 00 00 00 00 02 B2 D1
                  39 01 00 00 00 00 02 88 0B
                  39 01 00 00 00 00 02 35 1F
                  39 01 00 00 00 00 02 3A 24
                  39 01 00 00 00 00 02 33 00
                  39 01 00 00 00 00 02 7A 0F
                  39 01 00 00 00 00 02 B5 07
                  39 01 00 00 00 00 04 FF 98 81 01
                  39 01 00 00 00 00 02 22 0A
                  39 01 00 00 00 00 02 31 00
                  39 01 00 00 00 00 02 53 77
                  39 01 00 00 00 00 02 55 6E
                  39 01 00 00 00 00 02 50 C0
                  39 01 00 00 00 00 02 51 C0
                  39 01 00 00 00 00 02 60 1F
                  39 01 00 00 00 00 02 61 00
                  39 01 00 00 00 00 02 62 20
                  39 01 00 00 00 00 02 63 00
                  39 01 00 00 00 00 02 2E F0
                  39 01 00 00 00 00 02 A0 05
                  39 01 00 00 00 00 02 A1 0F
                  39 01 00 00 00 00 02 A2 1A
                  39 01 00 00 00 00 02 A3 10
                  39 01 00 00 00 00 02 A4 13
                  39 01 00 00 00 00 02 A5 27
                  39 01 00 00 00 00 02 A6 1B
                  39 01 00 00 00 00 02 A7 1E
                  39 01 00 00 00 00 02 A8 5D
                  39 01 00 00 00 00 02 A9 1B
                  39 01 00 00 00 00 02 AA 27
                  39 01 00 00 00 00 02 AB 4A
                  39 01 00 00 00 00 02 AC 18
                  39 01 00 00 00 00 02 AD 16
                  39 01 00 00 00 00 02 AE 4A
                  39 01 00 00 00 00 02 AF 20
                  39 01 00 00 00 00 02 B0 26
                  39 01 00 00 00 00 02 B1 48
                  39 01 00 00 00 00 02 B2 5E
                  39 01 00 00 00 00 02 B3 3F
                  39 01 00 00 00 00 02 C0 04
                  39 01 00 00 00 00 02 C1 0D
                  39 01 00 00 00 00 02 C2 19
                  39 01 00 00 00 00 02 C3 11
                  39 01 00 00 00 00 02 C4 13
                  39 01 00 00 00 00 02 C5 26
                  39 01 00 00 00 00 02 C6 1C
                  39 01 00 00 00 00 02 C7 1E
                  39 01 00 00 00 00 02 C8 5C
                  39 01 00 00 00 00 02 C9 1C
                  39 01 00 00 00 00 02 CA 28
                  39 01 00 00 00 00 02 CB 48
                  39 01 00 00 00 00 02 CC 18
                  39 01 00 00 00 00 02 CD 16
                  39 01 00 00 00 00 02 CE 4B
                  39 01 00 00 00 00 02 CF 20
                  39 01 00 00 00 00 02 D0 28
                  39 01 00 00 00 00 02 D1 47
                  39 01 00 00 00 00 02 D2 5E
                  39 01 00 00 00 00 02 D3 3F
                  39 01 00 00 00 00 04 FF 98 81 00
                  05 01 00 00 78 00 02 11 00
                  05 01 00 00 14 00 02 29 00];
		qcom,mdss-dsi-off-command = [05 01 00 00 32 00 02 28 00
			05 01 00 00 78 00 02 10 00];
		qcom,mdss-dsi-on-command-state = "dsi_lp_mode";
		qcom,mdss-dsi-off-command-state = "dsi_lp_mode";
		qcom,mdss-dsi-h-sync-pulse = <1>;
		qcom,mdss-dsi-traffic-mode = "burst_mode";
		qcom,mdss-dsi-lane-map = "lane_map_0123";
		qcom,mdss-dsi-bllp-eof-power-mode;
		qcom,mdss-dsi-bllp-power-mode;
		qcom,mdss-dsi-lane-0-state;
		qcom,mdss-dsi-lane-1-state;
		qcom,mdss-dsi-lane-2-state;
		qcom,mdss-dsi-lane-3-state;
		qcom,mdss-dsi-panel-timings-phy-v2 = [1E 1B 04 06 02 03 04 0a
			1E 1B 04 06 02 03 04 0a
			1E 1B 04 06 02 03 04 0a
			1E 1B 04 06 02 03 04 0a
			1E 1D 04 05 02 03 04 0a];
		qcom,mdss-dsi-t-clk-post = <0x0a>;
		qcom,mdss-dsi-t-clk-pre = <0x1d>;
		qcom,mdss-dsi-bl-min-level = <1>;
		qcom,mdss-dsi-bl-max-level = <4095>;
		qcom,mdss-dsi-dma-trigger = "trigger_sw";
		qcom,mdss-dsi-mdp-trigger = "none";
		qcom,mdss-dsi-bl-pmic-control-type = "bl_ctrl_wled";
		qcom,mdss-dsi-reset-sequence = <1 20>, <0 2>, <1 20>;
//		qcom,mdss-dsi-post-init-delay = <5>;
		qcom,mdss-dsi-lp11-init;
/* Huaqin add for Reduce the bright screen time by qimaokang at 2018/5/2 start */
		/* qcom,mdss-dsi-init-delay-us = <120000>; */
/* Huaqin add for Reduce the bright screen time by qimaokang at 2018/5/2 end */
                qcom,esd-check-enabled;
                qcom,mdss-dsi-panel-status-command      = [06 01 00 01 05 00 01 0A];
                qcom,mdss-dsi-panel-status-command-mode = "dsi_lp_mpde";
                qcom,mdss-dsi-panel-status-check-mode   = "reg_read";
                qcom,mdss-dsi-panel-status-read-length  = <1>;
                qcom,mdss-dsi-panel-status-valid-params = <1>;
                qcom,mdss-dsi-panel-status-value        = <0x9C>;
                qcom,mdss-dsi-panel-max-error-count     = <3>;
	};
};
