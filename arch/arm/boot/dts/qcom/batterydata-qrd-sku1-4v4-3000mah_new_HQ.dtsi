
qcom,qrd_msm8937_sku1_2920mah {
	/* #QRD8937_2800mAh_China_data_averaged_MasterSlave_Oct30th2015*/
	qcom,max-voltage-uv = <4400000>;
	qcom,nom-batt-capacity-mah = <3000>;
	qcom,batt-id-kohm = <39>;
	qcom,battery-beta = <3380>;
	qcom,battery-type = "qrd_msm8937_sku1_2800mah";
	qcom,fastchg-current-ma = <2000>;
	qcom,fg-cc-cv-threshold-mv = <4390>;
	qcom,chg-rslow-comp-c1 = <6733839>;
	qcom,chg-rslow-comp-c2 = <23336040>;
	qcom,chg-rs-to-rslow = <1049243>;
	qcom,chg-rslow-comp-thr = <0xDB>;
	qcom,checksum = <0x7E2A>;
	qcom,gui-version = "PMI8950GUI - 2.0.0.14";
	qcom,fg-profile-data = [
		DC 83 AC 7C
		F4 80 E9 76
		50 83 92 61
		6B 7A 93 85
		53 82 83 98
		70 B6 55 C2
		52 0F 36 88
		C4 84 46 88
		DC 7E 46 83
		B4 72 27 7C
		65 6A 1E 81
		D8 A1 02 C5
		C4 D1 68 0E
		7E 0B C4 5A
		14 70 B2 FD
		08 2C 4C 3E
		97 38 00 00
		0C 4C 75 30
		C6 42 00 00
		00 00 00 00
		00 00 00 00
		3D 71 25 70
		58 6A 01 89
		FA 75 50 69
		5B 64 CC 7A
		5B 74 E2 61
		93 6E 19 A1
		21 1C 68 3E
		67 A0 71 0C
		28 00 FF 36
		F0 11 30 03
		00 00 00 0C
	];
};

