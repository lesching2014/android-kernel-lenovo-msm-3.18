
qcom,3073638_huaqin_ql1618atl_3030mah_averaged_masterslave_sept5th2017 {
	/* #3073638_Huaqin_QL1618atl_3030mAh_averaged_MasterSlave_Sept5th2017*/
	qcom,max-voltage-uv = <4400000>;
	qcom,nom-batt-capacity-mah = <3030>;
	qcom,batt-id-kohm = <200>;
	qcom,battery-beta = <3380>;
	qcom,battery-type = "3073638_huaqin_ql1618atl_3030mah";
	qcom,thermal-coefficients = [DA 86 F0 50 08 3C];
	qcom,chg-rslow-comp-c1 = <3099640>;
	qcom,chg-rslow-comp-c2 = <4620036>;
	qcom,chg-rs-to-rslow = <962256>;
	qcom,chg-rslow-comp-thr = <0xA9>;
	qcom,fastchg-current-ma = <2000>;
	qcom,fg-cc-cv-threshold-mv = <4390>;
	qcom,checksum = <0xF1F6>;
	qcom,gui-version = "PMI8950GUI - 2.0.0.16";
	qcom,fg-profile-data = [
		 E3 83 F0 7C
		 1C 81 31 77
		 64 83 6D 74
		 95 89 B4 94
		 2C 82 B2 99
		 99 BC 06 C9
		 56 10 F6 83
		 16 7D 0C 81
		 C9 76 5D 83
		 4D 40 E0 82
		 12 8F 6F 82
		 53 98 80 B6
		 90 C2 52 12
		 3C 0C 04 5B
		 14 70 B2 FD
		 9D 3C 0B 44
		 77 39 00 00
		 2D 4C E5 29
		 0B 40 00 00
		 00 00 00 00
		 00 00 00 00
		 01 70 F7 6A
		 DF 60 13 82
		 3A 75 08 68
		 B9 5E 12 7A
		 E5 74 7C 63
		 52 61 02 AB
		 15 CC 61 AF
		 5E A0 71 0C
		 28 00 FF 36
		 F0 11 30 03
		 00 00 00 0C
	];
};

